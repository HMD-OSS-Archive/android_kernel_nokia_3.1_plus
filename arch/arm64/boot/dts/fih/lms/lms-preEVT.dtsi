/* LMS EVT SDM429/439 */

/* MemMap parts */
#include "../common/memmap-evb.dtsi"

/* Common DT Info */
#include "../common/common_info_v1.dtsi"

/* SYSTEM parts */
#include "../common/system.dtsi"

/* External LDO control */

/* Keypad parts */
#include "misc/keypad.dtsi"

/* PMIC parts */

/* GPIO parts */

/* Peripheral */

/* Charging */
#include "power/sdm439-pmi632-fih.dtsi"

/* Audio */
#include "audio/sdm439-internal-audio_lms.dtsi"

/* Camera */
#include "camera/camera-lms-evt.dtsi"

/* Haptic */
#include "misc/vibrator.dtsi"
/* SD */
#include "misc/sd-evt.dtsi"

/* Fingerprint */

/* Sensor */

/* Touch */
#include "touch/touch-focaltech_7311.dtsi"

/* LCM */
#include "display/LMS_mdss_panel_common.dtsi"
#include "display/dsi-panel-hx8352-tm-240x400-video.dtsi"
#include "display/bridge-tc358762.dtsi"



/* Samsung NFC */
#include "samsungnfc/lms_avl8895_i2c.dtsi"


/* CYWPRESS bluetooth */
#include "cywpress/lms_cyw_bt.dtsi"

/* Thermal */
#include "thermal/thermal.dtsi"
