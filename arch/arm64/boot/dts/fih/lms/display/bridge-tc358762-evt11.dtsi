&i2c_6 {
        tc358762@0b {
        	status = "disabled";
        };
};


&i2c_3 {
        status = "okay";
        tc358762@0b {
                compatible = "toshiba,tc358762";
                reg = <0x0b>;
        };
};
