/* Copyright (c) 2013, The Linux Foundation. All rights reserved.
 *
 * This program is free software; you can redistribute it and/or modify
 * it under the terms of the GNU General Public License version 2 and
 * only version 2 as published by the Free Software Foundation.
 *
 * This program is distributed in the hope that it will be useful,
 * but WITHOUT ANY WARRANTY; without even the implied warranty of
 * MERCHANTABILITY or FITNESS FOR A PARTICULAR PURPOSE.  See the
 * GNU General Public License for more details.
 */

/*---------------------------------------------------------------------------
 * This file is autogenerated file using gcdb parser. Please do not edit it.
 * Update input XML file to add a new entry or update variable in this file
 * VERSION = "1.0"
 *---------------------------------------------------------------------------*/
&mdss_mdp {
	dsi_hx8352_tm_240x400_vid: fih,mdss_dsi_hx8352_tm_240x400_video {
		fih,panel-id = <8>;
		qcom,mdss-dsi-panel-name = "HIMAX HX8352 video mode dsi 240x400 tinama panel";
		qcom,mdss-dsi-panel-controller = <&mdss_dsi0>;
		qcom,mdss-dsi-panel-type = "dsi_video_mode";
		qcom,mdss-dsi-panel-destination = "display_1";
		qcom,mdss-dsi-panel-framerate = <60>;
		qcom,mdss-dsi-virtual-channel-id = <0>;
		qcom,mdss-dsi-stream = <0>;
		qcom,mdss-dsi-panel-width = <240>;
		qcom,mdss-dsi-panel-height = <400>;
		qcom,mdss-dsi-h-front-porch = <62>;
		qcom,mdss-dsi-h-back-porch = <50>;
		qcom,mdss-dsi-h-pulse-width = <40>;
		qcom,mdss-dsi-h-sync-skew = <0>;
		qcom,mdss-dsi-v-front-porch = <40>;		
		qcom,mdss-dsi-v-back-porch = <40>;
		qcom,mdss-dsi-v-pulse-width = <20>;
		qcom,mdss-dsi-h-left-border = <0>;
		qcom,mdss-dsi-h-right-border = <0>;
		qcom,mdss-dsi-v-top-border = <0>;
		qcom,mdss-dsi-v-bottom-border = <0>;
		qcom,mdss-dsi-bpp = <16>;
		qcom,mdss-dsi-color-order = "rgb_swap_rgb";
		qcom,mdss-dsi-underflow-color = <0xff>;
		qcom,mdss-dsi-border-color = <0>;
		
		qcom,mdss-dsi-on-command = [
		];
		
		qcom,mdss-dsi-off-command = [
		];

		qcom,mdss-dsi-on-command-state = "dsi_lp_mode";
		qcom,mdss-dsi-off-command-state = "dsi_hs_mode";

		qcom,mdss-dsi-h-sync-pulse = <1>;
		qcom,mdss-dsi-traffic-mode = "non_burst_sync_event";
		qcom,mdss-dsi-lane-map = "lane_map_0123";
		qcom,mdss-dsi-bllp-eof-power-mode;
		qcom,mdss-dsi-bllp-power-mode;
		qcom,mdss-dsi-lane-0-state;
		qcom,mdss-dsi-lane-1-state;
		qcom,mdss-dsi-t-clk-post = <0x05>;
		qcom,mdss-dsi-t-clk-pre = <0x10>;
		qcom,mdss-dsi-dma-trigger = "trigger_sw";
		qcom,mdss-dsi-mdp-trigger = "none";
		
		qcom,mdss-dsi-reset-sequence = <0 2>, <1 5>;
		
		qcom,mdss-pan-physical-width-dimension = <39>;
		qcom,mdss-pan-physical-height-dimension = <65>;
		qcom,mdss-pan-physical-width-dimension-full = <3888>;
		qcom,mdss-pan-physical-height-dimension-full = <6480>;
		
		qcom,mdss-dsi-lp11-init;

		/* ESD Recover */
		fih,mdss-dsi-write-reg-command = [
			/*
			29 01 00 00 02 00 04 00 05 01 00
			29 01 00 00 02 00 04 00 05 02 00
			29 01 00 00 02 00 04 00 05 03 00
			29 01 00 00 02 00 04 00 05 04 00
			29 01 00 00 02 00 04 00 05 05 EF
			29 01 00 00 02 00 04 00 05 06 00
			29 01 00 00 02 00 04 00 05 07 00
			29 01 00 00 02 00 04 00 05 08 01
			29 01 00 00 02 00 04 00 05 09 8F

			29 01 00 00 02 00 04 00 05 19 01
			29 01 00 00 02 00 04 00 05 1A 02
			29 01 00 00 02 00 04 00 05 1C 04

			29 01 00 00 02 00 04 00 05 23 6C
			29 01 00 00 02 00 04 00 05 24 77
			29 01 00 00 02 00 04 00 05 25 70

			29 01 00 00 02 00 04 00 05 80 00
			29 01 00 00 02 00 04 00 05 81 00
			29 01 00 00 02 00 04 00 05 82 00
			29 01 00 00 02 00 04 00 05 83 00
			*/

			29 01 00 00 02 00 04 00 05 01 00
			29 01 00 00 02 00 04 00 05 02 00
			29 01 00 00 02 00 04 00 05 03 00
			29 01 00 00 02 00 04 00 05 04 00
			29 01 00 00 02 00 04 00 05 05 EF
			29 01 00 00 02 00 04 00 05 06 00
			29 01 00 00 02 00 04 00 05 07 00
			29 01 00 00 02 00 04 00 05 08 01
			29 01 00 00 02 00 04 00 05 09 8F

			/*
			29 01 00 00 02 00 04 00 05 0A 00
			29 01 00 00 02 00 04 00 05 0B 00
			29 01 00 00 02 00 04 00 05 0C 01
			29 01 00 00 02 00 04 00 05 0D 8f
			29 01 00 00 02 00 04 00 05 0E 00
			29 01 00 00 02 00 04 00 05 0F 00
			29 01 00 00 02 00 04 00 05 10 01
			29 01 00 00 02 00 04 00 05 11 90
			29 01 00 00 02 00 04 00 05 12 00
			29 01 00 00 02 00 04 00 05 13 00
			29 01 00 00 02 00 04 00 05 14 00
			29 01 00 00 02 00 04 00 05 15 00
			*/

			29 01 00 00 02 00 04 00 05 16 0b
			29 01 00 00 02 00 04 00 05 17 65
			/*
			29 01 00 00 02 00 04 00 05 18 8f
			*/
			29 01 00 00 02 00 04 00 05 19 01

			29 01 00 00 02 00 04 00 05 1A 02
			29 01 00 00 02 00 04 00 05 1B 1e
			29 01 00 00 02 00 04 00 05 1C 04
			/*
			29 01 00 00 02 00 04 00 05 1D 20
			29 01 00 00 02 00 04 00 05 1E 10
			*/
			29 01 00 00 02 00 04 00 05 1F d4

			29 01 00 00 02 00 04 00 05 23 6C
			29 01 00 00 02 00 04 00 05 24 77
			29 01 00 00 02 00 04 00 05 25 70

			29 01 00 00 02 00 04 00 05 26 33
			29 01 00 00 02 00 04 00 05 27 93
			29 01 00 00 02 00 04 00 05 28 3C
			/*
			29 01 00 00 02 00 04 00 05 29 01
			29 01 00 00 02 00 04 00 05 2A 00
			29 01 00 00 02 00 04 00 05 2B 03
			29 01 00 00 02 00 04 00 05 2C 1E
			*/
			29 01 00 00 02 00 04 00 05 2D 03
			29 01 00 00 02 00 04 00 05 2E 7b
			29 01 00 00 02 00 04 00 05 2F 01

			29 01 00 00 02 00 04 00 05 31 00
			29 01 00 00 02 00 04 00 05 32 00
			29 01 00 00 02 00 04 00 05 33 08
			29 01 00 00 02 00 04 00 05 34 02
			29 01 00 00 02 00 04 00 05 36 00
			/*
			29 01 00 00 02 00 04 00 05 38 00
			29 01 00 00 02 00 04 00 05 39 04
			29 01 00 00 02 00 04 00 05 3A 00
			29 01 00 00 02 00 04 00 05 3B ff
			*/
			29 01 00 00 02 00 04 00 05 3D 00

			29 01 00 00 02 00 04 00 05 60 08

			29 01 00 00 02 00 04 00 05 80 00
			29 01 00 00 02 00 04 00 05 81 00
			29 01 00 00 02 00 04 00 05 82 00
			29 01 00 00 02 00 04 00 05 83 00

			29 01 00 00 02 00 04 00 05 87 55

			29 01 00 00 02 00 04 00 05 E2 15
			29 01 00 00 02 00 04 00 05 E3 0a
			29 01 00 00 02 00 04 00 05 E4 00
			29 01 00 00 02 00 04 00 05 E5 00
			29 01 00 00 02 00 04 00 05 E6 00
			29 01 00 00 02 00 04 00 05 E7 00
			29 01 00 00 02 00 04 00 05 EA 00
			29 01 00 00 02 00 04 00 05 EC 08
			29 01 00 00 02 00 04 00 05 ED 47
			29 01 00 00 02 00 04 00 05 EE 20
			29 01 00 00 02 00 04 00 05 EF 48
			29 01 00 00 02 00 04 00 05 FF 00
			29 01 00 00 02 00 04 00 05 2A 00
		];
		fih,mdss-dsi-write-reg-command-state = "dsi_hs_mode";

		qcom,mdss-dsi-tx-eot-append;
	};
};


&dsi_hx8352_tm_240x400_vid {
	/delete-property/ qcom,mdss-dsi-panel-timings;
	qcom,mdss-dsi-panel-timings = [
		7B 1A 10 00 3E 40 16 1E 15 03 04 00
	];

	qcom,mdss-dsi-panel-timings-phy-v2 = [
		1E 1C 04 06 02 03 04 a0
		1E 1C 04 06 02 03 04 a0
		1E 1C 04 06 02 03 04 a0
		1E 1C 04 06 02 03 04 a0
		1E 1C 04 06 02 03 04 a0
	];

	qcom,mdss-dsi-panel-timings-phy-12nm = [
		00 03 06 00 00 01 00 04
	];

	qcom,mdss-dsi-bl-pmic-control-type = "bl_ctrl_pwm";
	qcom,mdss-dsi-bl-pmic-pwm-frequency = <40>;
	qcom,mdss-dsi-bl-pmic-bank-select = <0>;
	qcom,mdss-dsi-pwm-gpio = <&pm8953_gpios 8 0>;

	/* PMI439 Can Not Ouput Signal When Frequency Is Set As 25KHZ And Bl Level is less than 4 */
	qcom,mdss-dsi-bl-min-level = <4>;

  qcom,panel-supply-entries = <&dsi_panel_pwr_supply>;

	/* ESD Check Setting */
	qcom,esd-check-enabled;
	qcom,mdss-dsi-panel-status-check-mode = "reg_read";
	qcom,mdss-dsi-panel-status-command = [
		06 01 00 01 00 00 01 0a
	];
	qcom,mdss-dsi-panel-status-command-state = "dsi_hs_mode";
	qcom,mdss-dsi-panel-status-value = <0x9C>;
	qcom,mdss-dsi-panel-on-check-value = <0x9c>;
	qcom,mdss-dsi-panel-status-read-length = <1>;
	qcom,mdss-dsi-panel-max-error-count = <3>;  
};
