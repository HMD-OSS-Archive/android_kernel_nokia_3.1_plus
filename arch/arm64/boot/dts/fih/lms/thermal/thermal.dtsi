&quiet_modem_439_trip1 {
	temperature = <99000>;
	hysteresis = <1000>;
};

&quiet_modem_439_trip2 {
	temperature = <99000>;
	hysteresis = <1000>;
};

&quiet_modem_439_trip3 {
	temperature = <99000>;
	hysteresis = <1000>;
};

&quiet_modem_439_trip4 {
	temperature = <99000>;
	hysteresis = <1000>;
};
