/* LMS EVT SDM429/439 */

/* inherit EVT Settings */
#include "lms-EVT2.dtsi"

/* Diff */

/* Charging */
#include "power/sdm439-pmi632-fih-preDVT.dtsi"

/* SAR Decrease Method*/
#include "karkit/karkit-gpio.dtsi"

/* cypress flash */
#include "cywpress/lms_cyw_bt_dvt.dtsi"
