## drivers/input/touchscreen/mediatek/Kconfig
```kconfig
#
# Touchscreen driver configuration
#
menuconfig INPUT_TOUCHSCREEN
	bool "Touchscreens"
	help
	  Say Y here, and a list of supported touchscreens will be displayed.
	  This option doesn't affect the kernel.

	  If unsure, say Y.

if INPUT_TOUCHSCREEN

config TOUCHSCREEN_MTK
	bool "MediaTek Touch Panel Driver"
	help
	  Say Y here if you have MediaTek touch panel.

	  If unsure, say N.

	  To compile this dirver as a module, choose M here: the
	  module will be called.

config TOUCHSCREEN_PHYSICAL_ROTATION_WITH_LCM
	bool "MediaTek Touch Panel Rotation With LCM"
	default y
	help
	  Say N here if touch panel is not physical rotated as LCM does.
	  Physically rotated means that this driver will map
	  the reported coordination to diagonal position.

	  If unsure, say Y.
config TOUCHSCREEN_MTK_SOLOMON
	bool "SOLOMON for Mediatek package"
	default n
	help
	  Say Y here if you have SOLOMON touch panel.

	  If unsure, say N.

	  To compile this dirver as a module, choose M here: the
	  module will be called.

source "drivers/input/touchscreen/mediatek/SOLOMON/Kconfig"

config TOUCHSCREEN_MTK_FOCALTECH_TS
	bool "FOCALTECH_TS for Mediatek package"
	default n
	help
	  Say Y here if you have focaltech_touch touch panel.

	  If unsure, say N.

	  To compile this dirver as a module, choose M here: the
	  module will be called.

source "drivers/input/touchscreen/mediatek/focaltech_touch/Kconfig"

config TOUCHSCREEN_MTK_FOCALTECH_8006
	bool "FOCALTECH_TS for Mediatek package"
	default n
	help
	  Say Y here if you have focaltech_touch touch panel.

	  If unsure, say N.

	  To compile this dirver as a module, choose M here: the
	  module will be called.

source "drivers/input/touchscreen/mediatek/focaltech8006P_touch/Kconfig"

config TOUCHSCREEN_MTK_GT1151
	bool "GT1151 for Mediatek package"
	default n
	help
	  Say Y here if you have GT1151 touch panel.

	  If unsure, say N.

	  To compile this dirver as a module, choose M here: the
	  module will be called.

source "drivers/input/touchscreen/mediatek/GT1151/Kconfig"

config TOUCHSCREEN_MTK_NT36xxx
	bool "NT36xxx for Mediatek package"
	default n
	help
	  Say Y here if you have NT36xxx touch panel.

	  If unsure, say N.

	  To compile this dirver as a module, choose M here: the
	  module will be called.

source "drivers/input/touchscreen/mediatek/NT36xxx/Kconfig"




config TOUCHSCREEN_HIMAX_CHIPSET
        bool "Himax touchpane HIMAX_CHIPSET for mtk platform"
	depends on I2C
        default n
        help
          Say Y here if you have HIMAX touch panel.

          If unsure, say N.

          To compile this dirver as a module, choose M here: the
          module will be called.


#source "drivers/input/touchscreen/mediatek/hxchipset/Kconfig"



config TOUCHSCREEN_MTK_ILI988H
        bool "ILI988H chipset for mtk platform"
        default n
        help
          Say Y here if you have HIMAX touch panel.

          If unsure, say N.

          To compile this dirver as a module, choose M here: the
          module will be called.


config TOUCHSCREEN_HIMAX_CHIPSET_I2C
	bool "Himax touchpanel CHIPSET I2C"
	depends on I2C
	help
	  Say Y here if you have a Himax I2C CHIPSET touchscreen.
	  HIMAX controllers are multi touch controllers which can
	  report 10 touches at a time.

          If unsure, say N.
#source "drivers/input/touchscreen/mediatek/hxchipset_i2c/Kconfig"

source "drivers/input/touchscreen/mediatek/hxchipset/Kconfig"

endif
```
